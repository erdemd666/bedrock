## os/Config.in
```kconfig
source "$BR2_EXTERNAL_BEDROCK_PATH/package/bedrock/Config.in"
source "$BR2_EXTERNAL_BEDROCK_PATH/package/bedrock-gpu/Config.in"
```

## os/configs/bedrock_i686_defconfig
```kconfig
BR2_x86_i686=y
BR2_TOOLCHAIN_EXTERNAL=y
BR2_TOOLCHAIN_EXTERNAL_BOOTLIN=y
BR2_TOOLCHAIN_EXTERNAL_BOOTLIN_X86_I686_MUSL_STABLE=y
BR2_STATIC_LIBS=y
BR2_TARGET_GENERIC_HOSTNAME="bedrock"
BR2_TARGET_GENERIC_ISSUE="Bedrock · built by erdem6.com"
# BR2_TARGET_GENERIC_GETTY is not set
BR2_ROOTFS_OVERLAY="$(BR2_EXTERNAL_BEDROCK_PATH)/board/bedrock/rootfs-overlay"
BR2_LINUX_KERNEL=y
BR2_LINUX_KERNEL_USE_CUSTOM_CONFIG=y
BR2_LINUX_KERNEL_CUSTOM_CONFIG_FILE="$(BR2_EXTERNAL_BEDROCK_PATH)/board/bedrock/linux.config"
BR2_LINUX_KERNEL_CONFIG_FRAGMENT_FILES="$(BR2_EXTERNAL_BEDROCK_PATH)/board/bedrock/linux-i686.config $(BR2_EXTERNAL_BEDROCK_PATH)/board/bedrock/linux-health.config $(BR2_EXTERNAL_BEDROCK_PATH)/board/bedrock/linux-fleet.config $(BR2_EXTERNAL_BEDROCK_PATH)/board/bedrock/linux-fleet-i686.config $(BR2_EXTERNAL_BEDROCK_PATH)/board/bedrock/linux-board.config $(BR2_EXTERNAL_BEDROCK_PATH)/board/bedrock/linux-functional.config $(BR2_EXTERNAL_BEDROCK_PATH)/board/bedrock/linux-functional-i686.config"
BR2_PACKAGE_BEDROCK=y
BR2_TARGET_ROOTFS_INITRAMFS=y
# BR2_TARGET_ROOTFS_TAR is not set
BR2_LINUX_KERNEL_PATCH="$(BR2_EXTERNAL_BEDROCK_PATH)/board/bedrock/patches"
BR2_PACKAGE_BUSYBOX_CONFIG_FRAGMENT_FILES="$(BR2_EXTERNAL_BEDROCK_PATH)/board/bedrock/busybox.fragment"
BR2_ROOTFS_POST_BUILD_SCRIPT="$(BR2_EXTERNAL_BEDROCK_PATH)/board/bedrock/post-build.sh"

# fleet
BR2_PACKAGE_LINUX_FIRMWARE=y
BR2_PACKAGE_LINUX_FIRMWARE_RTL_8169=y
```

## os/configs/bedrock_x86_64_defconfig
```kconfig
BR2_x86_64=y
BR2_TOOLCHAIN_EXTERNAL=y
BR2_TOOLCHAIN_EXTERNAL_BOOTLIN=y
BR2_TOOLCHAIN_EXTERNAL_BOOTLIN_X86_64_MUSL_STABLE=y
# stress: Mesa needs shared libraries; bedrock itself still links statically (tools/Makefile)
BR2_SHARED_STATIC_LIBS=y
BR2_TARGET_GENERIC_HOSTNAME="bedrock"
BR2_TARGET_GENERIC_ISSUE="Bedrock · built by erdem6.com"
# BR2_TARGET_GENERIC_GETTY is not set
BR2_ROOTFS_OVERLAY="$(BR2_EXTERNAL_BEDROCK_PATH)/board/bedrock/rootfs-overlay"
BR2_LINUX_KERNEL=y
BR2_LINUX_KERNEL_USE_CUSTOM_CONFIG=y
BR2_LINUX_KERNEL_CUSTOM_CONFIG_FILE="$(BR2_EXTERNAL_BEDROCK_PATH)/board/bedrock/linux.config"
BR2_LINUX_KERNEL_CONFIG_FRAGMENT_FILES="$(BR2_EXTERNAL_BEDROCK_PATH)/board/bedrock/linux-x86_64.config $(BR2_EXTERNAL_BEDROCK_PATH)/board/bedrock/linux-stress.config $(BR2_EXTERNAL_BEDROCK_PATH)/board/bedrock/linux-stress-gpu.config"
BR2_LINUX_KERNEL_NEEDS_HOST_LIBELF=y
BR2_PACKAGE_BEDROCK=y
BR2_TARGET_ROOTFS_INITRAMFS=y
# BR2_TARGET_ROOTFS_TAR is not set
BR2_LINUX_KERNEL_PATCH="$(BR2_EXTERNAL_BEDROCK_PATH)/board/bedrock/patches"
BR2_PACKAGE_BUSYBOX_CONFIG_FRAGMENT_FILES="$(BR2_EXTERNAL_BEDROCK_PATH)/board/bedrock/busybox.fragment"
BR2_ROOTFS_POST_BUILD_SCRIPT="$(BR2_EXTERNAL_BEDROCK_PATH)/board/bedrock/post-build.sh"
# stress
BR2_LINUX_KERNEL_XZ=y
BR2_PACKAGE_MESA3D=y
BR2_PACKAGE_MESA3D_LLVM=y
BR2_PACKAGE_MESA3D_GALLIUM_DRIVER_CROCUS=y
BR2_PACKAGE_MESA3D_GALLIUM_DRIVER_IRIS=y
BR2_PACKAGE_MESA3D_GALLIUM_DRIVER_NOUVEAU=y
BR2_PACKAGE_MESA3D_GALLIUM_DRIVER_RADEONSI=y
BR2_PACKAGE_MESA3D_GALLIUM_DRIVER_SWRAST=y
BR2_PACKAGE_MESA3D_OPENGL_EGL=y
BR2_PACKAGE_MESA3D_OPENGL_ES=y
BR2_PACKAGE_MESA3D_GBM=y
BR2_PACKAGE_LINUX_FIRMWARE=y
BR2_PACKAGE_LINUX_FIRMWARE_AMDGPU=y
BR2_PACKAGE_LINUX_FIRMWARE_I915=y
BR2_PACKAGE_LINUX_FIRMWARE_RADEON=y
BR2_PACKAGE_BEDROCK_GPU=y
```

## os/package/bedrock-gpu/Config.in
```kconfig
config BR2_PACKAGE_BEDROCK_GPU
	bool "bedrock-gpu"
	depends on BR2_PACKAGE_MESA3D_OPENGL_EGL
	depends on BR2_PACKAGE_MESA3D_OPENGL_ES
	depends on BR2_PACKAGE_MESA3D_GBM
	help
	  Headless GPU compute stress and video memory test that
	  bedrock runs, built from tools/gpu in this repository.
```

## os/package/bedrock/Config.in
```kconfig
config BR2_PACKAGE_BEDROCK
	bool "bedrock"
	help
	  Bedrock hardware diagnostics, built from tools/ in this
	  repository and installed as /usr/bin/bedrock.
```
